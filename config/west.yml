## config/west.yml
```yaml
manifest:
  defaults:
    revision: v0.3 # Change this!
  remotes:
    - name: zmkfirmware
      url-base: https://github.com/zmkfirmware
    - name: urob
      url-base: https://github.com/urob
  projects:
    - name: zmk
      remote: zmkfirmware
      revision: v0.3 # Change this!
      import: app/west.yml
    - name: zmk-unicode
      remote: urob
      revision: v0.3 # Change this to match ZMK version!
  self:
    path: config
```
